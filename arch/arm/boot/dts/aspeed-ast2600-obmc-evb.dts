/dts-v1/;

#include "aspeed-g6.dtsi"

/ {
	model = "AST2600 EVB";
	compatible = "aspeed,ast2600";

	aliases {
		serial4 = &uart5;
	};

	chosen {
		bootargs = "console=ttyS4,115200n8 root=/dev/ram rw init=/linuxrc";
	};

	memory@80000000 {
		reg = <0x80000000 0x40000000>;
	};

};
