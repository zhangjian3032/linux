## drivers/soc/pilot/Kconfig
```kconfig
source "drivers/soc/pilot/espi_vw/Kconfig"
source "drivers/soc/pilot/espi_oob/Kconfig"
source "drivers/soc/pilot/espi_mafs/Kconfig"
```

## drivers/soc/pilot/espi_mafs/Kconfig
```kconfig
config PILOT_ESPI_MAFS
	bool "pilot eSPI mafs driver"
	help
	  say Y to add support for eSPI
	  If unsure, say N
```

## drivers/soc/pilot/espi_oob/Kconfig
```kconfig
config PILOT_ESPI_OOB
	bool "pilot eSPI oob driver"
	help
	  say Y to add support for eSPI
	  If unsure, say N
```

## drivers/soc/pilot/espi_vw/Kconfig
```kconfig
config PILOT_ESPI_VW
	bool "pilot eSPI virtual wire interface driver"
	help
	  say Y to add support for eSPI
	  If unsure, say N
	  
```

## drivers/video/fbdev/aspeed/Kconfig
```kconfig
menuconfig FB_AST
	tristate "ASPEED Framebuffer Driver"
	depends on FB
	select FB_CFB_FILLRECT
	select FB_CFB_COPYAREA
	select FB_CFB_IMAGEBLIT
	default n

if FB_AST
config DISPLAY_SUPPORT
	bool "AST Display Support"

config AST_DAC
	bool "CRT DAC output"

config VGA_DDC
        bool "Enable VGA DDC Chanel"
        depends on FB_AST && AST_DAC && I2C_AST
	select FB_MODE_HELPERS
        help
          This option will support I2C DDC driver

config AST_DVO
	bool "CRT DVO output"

source "drivers/video/fbdev/aspeed/it66121/Kconfig"

endif
```

## drivers/video/fbdev/aspeed/it66121/Kconfig
```kconfig
config  HDMI_CAT66121
        bool "ITE HDMI transmitter IT66121 support"
	depends on AST_DVO
        help
           Support ITE HDMI transmitter IT66121 if you say y here.
```
