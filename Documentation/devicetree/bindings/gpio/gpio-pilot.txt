## Documentation/devicetree/bindings/mfd/aspeed,ast2600-pwm-tach.yaml
```yaml
# SPDX-License-Identifier: (GPL-2.0-only OR BSD-2-Clause)
# Copyright (C) 2021 ASPEED, Inc.
%YAML 1.2
---
$id: http://devicetree.org/schemas/mfd/aspeed,ast2600-pwm-tach.yaml#
$schema: http://devicetree.org/meta-schemas/core.yaml#

title: PWM Tach controller Device Tree Bindings

description: |
  The PWM Tach controller is represented as a multi-function device which
  includes:
    PWM
    Tach

maintainers:
  - Billy Tsai <billy_tsai@aspeedtech.com>

properties:
  compatible:
    items:
      - enum:
          - aspeed,ast2600-pwm-tach
      - const: syscon
      - const: simple-mfd
  reg:
    maxItems: 1
  clocks:
    maxItems: 1
  resets:
    maxItems: 1

required:
  - compatible
  - reg
  - clocks
  - resets

additionalProperties:
  type: object

examples:
  - |
    #include <dt-bindings/clock/ast2600-clock.h>
    pwm_tach: pwm_tach@1e610000 {
      compatible = "aspeed,ast2600-pwm-tach", "syscon", "simple-mfd";
      reg = <0x1e610000 0x100>;
      clocks = <&syscon ASPEED_CLK_AHB>;
      resets = <&syscon ASPEED_RESET_PWM>;

      pwm: pwm {
        compatible = "aspeed,ast2600-pwm";
        #pwm-cells = <3>;
      };
    };
```

## Documentation/devicetree/bindings/misc/aspeed-uart-routing.txt
```
======================================================================
Device tree bindings for Aspeed AST2400/AST2500 UART Routing Control Driver
======================================================================

The Aspeed AST2500 allows to dynamically route the inputs for the built-in
UARTS and physical serial I/O ports.

Required properties:
===================

 - compatible: must be one of:
	- "aspeed,ast2400-uart-routing"
	- "aspeed,ast2500-uart-routing"

Optional properties:
===================

The uart-routing node should be the child of a lpc node with the required
property:

- compatible : Should be one of the following:
		"aspeed,ast2400-lpc", "simple-mfd"
		"aspeed,ast2500-lpc", "simple-mfd"

Example
===================

g5 Example
----------

lpc: lpc@1e789000 {
	compatible = "aspeed,ast2500-lpc", "simple-mfd";
	reg = <0x1e789000 0x1000>;

	uart_routing: uart_routing@9c {
		compatible = "aspeed,ast2500-uart-routing";
		reg = <0x9c 0x4>;
	};
};
```

## Documentation/devicetree/bindings/peci/peci-aspeed.txt
```
Device tree configuration for PECI buses on the AST24XX and AST25XX SoCs.

Required properties:
- compatible        : Should be one of:
			"aspeed,ast2400-peci"
			"aspeed,ast2500-peci"
			"aspeed,ast2600-peci"
- reg               : Should contain PECI controller registers location and
		      length.
- #address-cells    : Should be <1> required to define a client address.
- #size-cells       : Should be <0> required to define a client address.
- interrupts        : Should contain PECI controller interrupt.
- clocks            : Should contain clock source for PECI controller. Should
		      reference the external oscillator clock in the second
		      cell.
- resets            : Should contain phandle to reset controller with the reset
		      number in the second cell.
- clock-frequency   : The bit frequency of PECI negotiation stage in units of Hz.
		      Driver will calculate the best divisor setting of msg-timing and
		      addr-timing to meet the value.
			  200~2000000

Optional properties:
- clock-sel-hclk    : At ast2600, peci can select the bus clock to Ref. clock (default) or HCLK.
      		  This value determine the bus clock mux to hclk.
- rd-sampling-point : Read sampling point selection. The whole period of a bit
		      time will be divided into 16 time frames. This value will
		      determine the time frame in which the controller will
		      sample PECI signal for data read back. Usually in the
		      middle of a bit time is the best.
		      0 ~ 15 (default: 8)
- cmd-timeout-ms    : Command timeout in units of ms.
		      1 ~ 60000 (default: 1000)
- 64byte-mode       : Enable 64 byte mode of peci transfer

Example:
	peci: bus@1e78b000 {
        compatible = "simple-bus";
        #address-cells = <1>;
        #size-cells = <1>;
        ranges = <0x0 0x1e78b000 0x60>;

        peci0: peci-bus@0 {
            compatible = "aspeed,ast2600-peci";
            reg = <0x0 0x100>;
            #address-cells = <1>;
            #size-cells = <0>;
            interrupts = <GIC_SPI 38 IRQ_TYPE_LEVEL_HIGH>;
            clocks = <&syscon ASPEED_CLK_GATE_REF0CLK>;
            resets = <&syscon ASPEED_RESET_PECI>;
            clock-frequency = <1000000>;
            rd-sampling-point = <8>;
            cmd-timeout-ms = <1000>;
        };
    };
```

## Documentation/devicetree/bindings/pinctrl/pinctrl-aspeed-pilot.txt
```
=========================
Aspeed Pilot Pin Controller
===========================  

directory for pilot pincontrol : drivers/pinctrl/pilot/
pilot4_pinctrl_drv.c : pin details of the soc (details of mux functions, configurations)
aspeed_pilot_pinctrl.c : definitions of callbacks required by pincontrol core.

arch/arm/boot/dts/pilot4.dtsi  :  DT node definitions
include/dt-bindings/pinctrl/pilot-pinctl.h  -- Arguments to the pinconfig properties are defined here.


===================
pincontroller node:
===================
                pincontroller: pincontroller@40100900{
                        compatible = "aspeed,pilot-pinctrl";
                        /* system level and clock control,  toplevel pin control , top level pad control , gpio */
                        reg = <0x40100100 0x10>,<0x40100900 0x34>,<0x40100B00 0xfe>;
                };

============================
pinmux and pinconf subnodes :
============================

The required properties of pinmux child nodes are:
- function: the mux function to select

Required properties of pinconf child nodes are:
- groups: the group which has the config details of pin


Optional properties of pinconf child nodes are:
- bias-pull-pin-default	: use pin-default pull state
- bias-pull-up		: pull up the pin
- bias-pull-down	: pull down the pin
- drive-strength        : sink or source at most X mA
- input-schmitt-enable	: enable schmitt-trigger mode


===================================================
pinmux and pinconf subnodes of pincontroller node:
===================================================
each subnode has function and groups properties.
The values of these two properties point to entries
in  the mux table and config table  respectively.
 
based on pad type of pin, optional config properties are added in config node.
padtype1:
	  bias-pull-down / bias-pull-up / bias-pull-pin-default
	  drive-strength 
padtype2:
	bias-pull-pin-default/ bias-pull-down /bias-pull-up
	drive-strength
	input-schmitt-enable
padtype3:
	bias-pull-down/bias-pull-up/bias-pull-pin-default

refer to pilot data sheet( section: TOP LEVEL PAD CONTROL) for more information.

Arguments to the drive-strength property are defined in 
include/dt-bindings/pinctrl/pilot-pinctl.h 

&pincontroller {


        UART0_CTS_N:UART0_CTS_N {
                groups = "uart0_cts_n_grp";
                function = "UART0_CTS_N";
        };
        UART0_DCD_N:UART0_DCD_N {
                groups = "uart0_dcd_n_grp";
                function = "UART0_DCD_N";
                bias-pull-up;
                drive-strength = <CURR_DRV_6MA>;
        };

. . .


};

Individual Device nodes can include phandles of these subnodes 
using pinctrl-property.
so whenever a new device is registered corresponding pins are configured by pincontrol driver.


===========
Examples:
============



sample subnode of pinmux-controller node:


       	 MAC0_TX_CLK:MAC0_TX_CLK {
                groups = "mac0_rx_er_grp";
                function = "MAC0_TX_CLK";
                drive-strength = <VG_DRV_2_5V_39_84_OHM>;
                input-schmitt-enable;
                bias-pull-down;
	};

	UART0_TXD:UART0_TXD {
		groups = "uart0_txd_grp";
                function = "UART0_TXD";
       	        drive-strength = <CURR_DRV_12MA>;
	};


	UART0_RXD:UART0_RXD {
               	groups = "uart0_rxd_grp";
                function = "UART0_RXD";
       	        bias-pull-up;
        };
	
===========================================
example device node with pinctrl-property:
===========================================
               uart0: serial@40430000 {
                        compatible = "ns16550a";
                        reg = <0x40430000 0x1000>;
                        reg-shift = <2>;
                        reg-io-width = <4>;
                        interrupts = <0 14 4>;
                        interrupt-parent = <&gic>;
                        clock-frequency = <1843200>;
                        highspeed-uart = <0>;
                        no-loopback-test;
                        pinctrl-names = "default";
                        pinctrl-0 = <&UART0_TXD>,<&UART0_RXD>,<&UART0_DCD_N>,<&UART0_DSR_N>,
				 	      <&UART0_DTR_N>,<&UART0_RI_N>,<&UART0_RTS_N>;


                };


reference documents:
=======================
Documentation/devicetree/bindings/pinctrl/pinctrl-bindings.txt	
Documentation/pinctrl.txt
```

## Documentation/devicetree/bindings/pwm/aspeed,ast2600-pwm.yaml
```yaml
# SPDX-License-Identifier: (GPL-2.0-only OR BSD-2-Clause)
# Copyright (C) 2021 ASPEED, Inc.
%YAML 1.2
---
$id: http://devicetree.org/schemas/pwm/aspeed,ast2600-pwm.yaml#
$schema: http://devicetree.org/meta-schemas/core.yaml#

title: ASPEED AST2600 PWM controller

maintainers:
  - Billy Tsai <billy_tsai@aspeedtech.com>

description: |
  The ASPEED PWM controller can support upto 16 PWM outputs.

properties:
  compatible:
    enum:
      - aspeed,ast2600-pwm

  "#pwm-cells":
    const: 3

additionalProperties: false

examples:
  - |
    // The PWM should be a subnode of a "aspeed,ast2600-pwm-tach" compatible
    // node.
    #include <dt-bindings/clock/ast2600-clock.h>
    pwm_tach: pwm_tach@1e610000 {
      compatible = "aspeed,ast2600-pwm-tach", "syscon", "simple-mfd";
      reg = <0x1e610000 0x100>;
      clocks = <&syscon ASPEED_CLK_AHB>;
      resets = <&syscon ASPEED_RESET_PWM>;

      pwm: pwm {
        compatible = "aspeed,ast2600-pwm";
        #pwm-cells = <3>;
      };
    };
```

## Documentation/devicetree/bindings/rng/aspeed-trng.txt
```
Aspeed TRNG (True Random Number Generator) block

Required properties:
- compatible : Should be "aspeed,ast2600-trng"
- reg : Offset and length of the register set of this block

Example:

trng@1e6e2530 {
	compatible = "aspeed,ast2600-trng";
	reg = <0x1e6e2530 0x8>;
};
```

## arch/arm/configs/aspeed_g6_obmc_defconfig
```kconfig
CONFIG_KERNEL_XZ=y
CONFIG_SYSVIPC=y
CONFIG_USELIB=y
CONFIG_NO_HZ_IDLE=y
CONFIG_HIGH_RES_TIMERS=y
CONFIG_PSI=y
CONFIG_PSI_DEFAULT_DISABLED=y
CONFIG_IKCONFIG=y
CONFIG_IKCONFIG_PROC=y
CONFIG_LOG_BUF_SHIFT=16
CONFIG_CGROUPS=y
CONFIG_BLK_DEV_INITRD=y
CONFIG_EXPERT=y
# CONFIG_UID16 is not set
# CONFIG_SYSFS_SYSCALL is not set
# CONFIG_AIO is not set
# CONFIG_RSEQ is not set
CONFIG_PERF_EVENTS=y
# CONFIG_VM_EVENT_COUNTERS is not set
# CONFIG_COMPAT_BRK is not set
CONFIG_SLAB=y
CONFIG_SLAB_FREELIST_RANDOM=y
CONFIG_ARCH_ASPEED=y
CONFIG_MACH_ASPEED_G6=y
# CONFIG_HARDEN_BRANCH_PREDICTOR is not set
# CONFIG_VDSO is not set
# CONFIG_CACHE_L2X0 is not set
# CONFIG_DEBUG_ALIGN_RODATA is not set
CONFIG_SMP=y
CONFIG_HAVE_ARM_ARCH_TIMER=y
CONFIG_VMSPLIT_2G=y
CONFIG_NR_CPUS=2
CONFIG_OABI_COMPAT=y
CONFIG_UACCESS_WITH_MEMCPY=y
CONFIG_SECCOMP=y
# CONFIG_ATAGS is not set
CONFIG_ZBOOT_ROM_TEXT=0x0
CONFIG_ZBOOT_ROM_BSS=0x0
# CONFIG_SUSPEND is not set
CONFIG_FIRMWARE_MEMMAP=y
CONFIG_JUMP_LABEL=y
CONFIG_MODULES=y
# CONFIG_LBDAF is not set
# CONFIG_BLK_DEV_BSG is not set
# CONFIG_BLK_DEBUG_FS is not set
# CONFIG_MQ_IOSCHED_DEADLINE is not set
# CONFIG_MQ_IOSCHED_KYBER is not set
# CONFIG_CORE_DUMP_DEFAULT_ELF_HEADERS is not set
# CONFIG_COMPACTION is not set
CONFIG_UEVENT_HELPER_PATH="/sbin/hotplug"
CONFIG_DEVTMPFS=y
CONFIG_DEVTMPFS_MOUNT=y
# CONFIG_PREVENT_FIRMWARE_BUILD is not set
CONFIG_MTD=y
CONFIG_MTD_SPI_NOR=y
CONFIG_MTD_UBI=y
CONFIG_BLK_DEV_LOOP=y
CONFIG_BLK_DEV_RAM=y
CONFIG_BLK_DEV_RAM_COUNT=1
CONFIG_BLK_DEV_RAM_SIZE=16384
CONFIG_SCSI=y
CONFIG_BLK_DEV_SD=y
CONFIG_INPUT_POLLDEV=y
CONFIG_INPUT_EVDEV=y
# CONFIG_KEYBOARD_ATKBD is not set
# CONFIG_INPUT_MOUSE is not set
# CONFIG_SERIO is not set
# CONFIG_VT is not set
# CONFIG_LEGACY_PTYS is not set
CONFIG_SERIAL_8250=y
# CONFIG_SERIAL_8250_DEPRECATED_OPTIONS is not set
CONFIG_SERIAL_8250_CONSOLE=y
CONFIG_SERIAL_8250_NR_UARTS=6
CONFIG_SERIAL_8250_RUNTIME_UARTS=6
CONFIG_SERIAL_8250_EXTENDED=y
CONFIG_SERIAL_8250_ASPEED_VUART=y
CONFIG_SERIAL_8250_SHARE_IRQ=y
CONFIG_SERIAL_OF_PLATFORM=y
# CONFIG_HW_RANDOM is not set
CONFIG_I2C=y
# CONFIG_I2C_COMPAT is not set
# CONFIG_I2C_HELPER_AUTO is not set
CONFIG_SPI=y
CONFIG_SPI_FMC=y
# CONFIG_HWMON is not set
CONFIG_THERMAL=y
CONFIG_WATCHDOG_SYSFS=y
# CONFIG_USB_SUPPORT is not set
CONFIG_SYNC_FILE=y
# CONFIG_VIRTIO_MENU is not set
# CONFIG_IOMMU_SUPPORT is not set
# CONFIG_ASPEED_BMC_MISC is not set
CONFIG_EXT2_FS=y
# CONFIG_MANDATORY_FILE_LOCKING is not set
CONFIG_OVERLAY_FS=y
CONFIG_TMPFS=y
CONFIG_SQUASHFS=y
CONFIG_SQUASHFS_XZ=y
CONFIG_SQUASHFS_ZSTD=y
CONFIG_NLS=y
CONFIG_HARDENED_USERCOPY=y
CONFIG_FORTIFY_SOURCE=y
CONFIG_CRYPTO=y
# CONFIG_CRYPTO_ECHAINIV is not set
CONFIG_CRYPTO_HMAC=y
CONFIG_CRYPTO_CRC32C=y
CONFIG_CRYPTO_SHA256=y
CONFIG_CRYPTO_AES=y
CONFIG_CRYPTO_DEFLATE=y
CONFIG_CRYPTO_LZO=y
# CONFIG_CRYPTO_HW is not set
CONFIG_CRC16=y
CONFIG_CRC4=y
CONFIG_CRC8=y
# CONFIG_XZ_DEC_X86 is not set
# CONFIG_XZ_DEC_POWERPC is not set
# CONFIG_XZ_DEC_IA64 is not set
# CONFIG_XZ_DEC_SPARC is not set
CONFIG_PRINTK_TIME=y
CONFIG_DYNAMIC_DEBUG=y
CONFIG_DEBUG_INFO=y
CONFIG_DEBUG_INFO_REDUCED=y
CONFIG_DEBUG_INFO_DWARF4=y
CONFIG_GDB_SCRIPTS=y
CONFIG_STRIP_ASM_SYMS=y
CONFIG_SOFTLOCKUP_DETECTOR=y
# CONFIG_DETECT_HUNG_TASK is not set
CONFIG_WQ_WATCHDOG=y
CONFIG_PANIC_ON_OOPS=y
CONFIG_PANIC_TIMEOUT=-1
# CONFIG_SCHED_DEBUG is not set
CONFIG_SCHED_STACK_END_CHECK=y
# CONFIG_RCU_TRACE is not set
CONFIG_FUNCTION_TRACER=y
# CONFIG_RUNTIME_TESTING_MENU is not set
CONFIG_DEBUG_WX=y
CONFIG_DEBUG_USER=y
```
