## arch/arm/configs/pilot4_defconfig
```kconfig
CONFIG_CROSS_COMPILE="arm-aspeed-linux-gnueabi-"
# CONFIG_SWAP is not set
CONFIG_SYSVIPC=y
# CONFIG_CROSS_MEMORY_ATTACH is not set
# CONFIG_USELIB is not set
CONFIG_CGROUPS=y
CONFIG_CGROUP_FREEZER=y
CONFIG_CGROUP_PIDS=y
CONFIG_CGROUP_DEVICE=y
CONFIG_CPUSETS=y
CONFIG_CGROUP_CPUACCT=y
CONFIG_MEMCG=y
CONFIG_CGROUP_SCHED=y
CONFIG_BLK_CGROUP=y
CONFIG_USER_NS=y
CONFIG_BLK_DEV_INITRD=y
# CONFIG_COMPAT_BRK is not set
# CONFIG_LBDAF is not set
# CONFIG_BLK_DEV_BSG is not set
# CONFIG_IOSCHED_DEADLINE is not set
# CONFIG_IOSCHED_CFQ is not set
CONFIG_MACH_PILOT4_ASIC=y
# CONFIG_CACHE_L2X0 is not set
CONFIG_ARM_ERRATA_430973=y
CONFIG_ARM_ERRATA_720789=y
CONFIG_ARM_ERRATA_754322=y
CONFIG_ARM_ERRATA_754327=y
CONFIG_ARM_ERRATA_764369=y
CONFIG_ARM_ERRATA_775420=y
CONFIG_ARM_ERRATA_798181=y
CONFIG_ARM_ERRATA_773022=y
CONFIG_SMP=y
CONFIG_NR_CPUS=2
CONFIG_AEABI=y
# CONFIG_ATAGS is not set
CONFIG_ARM_APPENDED_DTB=y
CONFIG_ARM_ATAG_DTB_COMPAT=y
CONFIG_VFP=y
# CONFIG_SUSPEND is not set
CONFIG_NET=y
CONFIG_PACKET=y
CONFIG_UNIX=y
CONFIG_UNIX_DIAG=y
CONFIG_XFRM_SUB_POLICY=y
CONFIG_XFRM_MIGRATE=y
CONFIG_NET_KEY=y
CONFIG_INET=y
CONFIG_NET_IPIP=y
CONFIG_TCP_CONG_ADVANCED=y
# CONFIG_TCP_CONG_BIC is not set
# CONFIG_TCP_CONG_WESTWOOD is not set
# CONFIG_TCP_CONG_HTCP is not set
# CONFIG_IPV6 is not set
CONFIG_CGROUP_NET_PRIO=y
CONFIG_CGROUP_NET_CLASSID=y
# CONFIG_WIRELESS is not set
CONFIG_DEVTMPFS=y
CONFIG_DEVTMPFS_MOUNT=y
# CONFIG_FIRMWARE_IN_KERNEL is not set
CONFIG_MTD=y
CONFIG_MTD_BLOCK=y
CONFIG_MTD_PARTITIONED_MASTER=y
CONFIG_MTD_SPI=y
CONFIG_MTD_PILOT_AVL=y
CONFIG_MTD_PILOT4_SPI=y
CONFIG_MAX_BOOT_SPI_BANKS=1
CONFIG_MAX_BKUP_SPI_BANKS=0
CONFIG_MAX_HOST_SPI_BANKS=0
CONFIG_MTD_BLOCK2MTD=y
CONFIG_MTD_UBI=y
CONFIG_NETDEVICES=y
CONFIG_BONDING=y
# CONFIG_NET_VENDOR_ARC is not set
# CONFIG_NET_CADENCE is not set
# CONFIG_NET_VENDOR_BROADCOM is not set
# CONFIG_NET_VENDOR_CIRRUS is not set
CONFIG_PILOT4_NET_TULIP=y
# CONFIG_NET_VENDOR_EZCHIP is not set
# CONFIG_NET_VENDOR_FARADAY is not set
# CONFIG_NET_VENDOR_HISILICON is not set
# CONFIG_NET_VENDOR_INTEL is not set
# CONFIG_NET_VENDOR_MARVELL is not set
# CONFIG_NET_VENDOR_MICREL is not set
# CONFIG_NET_VENDOR_NATSEMI is not set
# CONFIG_NET_VENDOR_QUALCOMM is not set
# CONFIG_NET_VENDOR_RENESAS is not set
# CONFIG_NET_VENDOR_ROCKER is not set
# CONFIG_NET_VENDOR_SAMSUNG is not set
# CONFIG_NET_VENDOR_SEEQ is not set
# CONFIG_NET_VENDOR_SMSC is not set
# CONFIG_NET_VENDOR_STMICRO is not set
# CONFIG_NET_VENDOR_SYNOPSYS is not set
# CONFIG_NET_VENDOR_VIA is not set
# CONFIG_NET_VENDOR_WIZNET is not set
CONFIG_PHYLIB=y
# CONFIG_WLAN is not set
# CONFIG_INPUT_MOUSEDEV is not set
# CONFIG_INPUT_KEYBOARD is not set
# CONFIG_INPUT_MOUSE is not set
# CONFIG_SERIO is not set
CONFIG_VT_HW_CONSOLE_BINDING=y
CONFIG_DEVPTS_MULTIPLE_INSTANCES=y
CONFIG_SERIAL_8250=y
CONFIG_SERIAL_8250_CONSOLE=y
CONFIG_SERIAL_8250_NR_UARTS=1
CONFIG_SERIAL_8250_RUNTIME_UARTS=1
# CONFIG_HW_RANDOM is not set
CONFIG_WATCHDOG=y
CONFIG_PILOT_WDT=y
# CONFIG_HID is not set
# CONFIG_USB_SUPPORT is not set
CONFIG_PILOT4_TIMER=y
# CONFIG_IOMMU_SUPPORT is not set
CONFIG_EXT2_FS=y
CONFIG_EXT3_FS=y
CONFIG_EXT3_FS_POSIX_ACL=y
CONFIG_FANOTIFY=y
CONFIG_AUTOFS4_FS=y
CONFIG_OVERLAY_FS=y
CONFIG_TMPFS=y
CONFIG_TMPFS_POSIX_ACL=y
CONFIG_CONFIGFS_FS=y
CONFIG_JFFS2_FS=y
CONFIG_JFFS2_FS_XATTR=y
CONFIG_JFFS2_COMPRESSION_OPTIONS=y
CONFIG_JFFS2_LZO=y
CONFIG_JFFS2_RUBIN=y
CONFIG_UBIFS_FS=y
CONFIG_SQUASHFS=y
CONFIG_SQUASHFS_LZ4=y
CONFIG_SQUASHFS_LZO=y
CONFIG_SQUASHFS_XZ=y
# CONFIG_NETWORK_FILESYSTEMS is not set
CONFIG_NLS=y
CONFIG_NLS_CODEPAGE_437=y
CONFIG_MAGIC_SYSRQ=y
# CONFIG_CRYPTO_ECHAINIV is not set
CONFIG_CRYPTO_CBC=y
# CONFIG_CRYPTO_HW is not set
CONFIG_CRC_T10DIF=y
CONFIG_LIBCRC32C=y
```

## arch/arm/mach-aspeed/Kconfig
```kconfig
if ARCH_ASPEED

menu "ASPEED AST SoC Selection"

choice
	prompt "ASPEED Processor Family"
	default CONFIG_IRMP

config IRMP
	bool "IRMP Serials"

config PCEXT
	bool "PC Extender Serials"

config REMOTEFX
	bool "RemoteFX Zero-Client Serials"

config RT360_CAM
	bool "Real Time 360 Cam"

endchoice

if IRMP

choice
	prompt "IRMP Serials"
	default CONFIG_ARCH_AST2300

config ARCH_AST2300
	select CPU_ARM926T
	bool "AST2300"

config ARCH_AST2400
	select CPU_ARM926T
	select USB_ARCH_HAS_EHCI
	bool "AST2400"

config ARCH_AST2500
	select CPU_V6
	select USB_ARCH_HAS_EHCI
	select EGFX_IRQ
	bool "AST2500"

endchoice

endif

if PCEXT

choice
	prompt "PC Extender Serials"
	default CONFIG_ARCH_AST1510

config ARCH_AST1500
	select CPU_ARM926T
	bool "AST1500"

config ARCH_AST1510
	select CPU_ARM926T
	bool "AST1510"

config ARCH_AST1520
	select CPU_V6
	select USB_ARCH_HAS_EHCI
	bool "AST1520"

endchoice

endif

if REMOTEFX

choice
	prompt "RemoteFX Zero-Client Serials"
	default CONFIG_ARCH_AST3100

config ARCH_AST3100
	select CPU_ARM926T
	select USB_ARCH_HAS_EHCI
	bool "AST3100"

config ARCH_AST3200
	select CPU_V6
	select USB_ARCH_HAS_EHCI
	select EGFX_IRQ
	bool "AST3200"

endchoice

endif

if RT360_CAM

choice
        prompt "Real Time 360 Cam Serials"
        default CONFIG_ARCH_AST1220

config ARCH_AST1220
        select CPU_V6
        bool "AST1220"

endchoice

config AST_CAM_FPGA
	bool "AST CAM FPGA"

endif

config AST_CVIC
	bool "AST CVIC"

config AST_SCU_LOCK
	bool "AST SCU Protection Key"

config AST1070_UART_DMA
	bool

endmenu

endif
```

## arch/arm/mach-aspeed/Kconfig.cam
```kconfig
if ARCH_ASPEED

menu "ASPEED AST SoC Selection"

choice
	prompt "ASPEED Processor Family"
	default CONFIG_RT360_CAM

config RT360_CAM
	bool "Real Time 360 Cam"

endchoice

if RT360_CAM

choice
        prompt "Real Time 360 Cam Serials"
        default CONFIG_ARCH_AST1220

config ARCH_AST1220
        select CPU_V6
        bool "AST1220"

endchoice

endif

config AST_CVIC
	bool "AST CVIC"

config AST_SCU_LOCK
	bool "AST SCU Protection Key"

config AST_UART_SDMA
	bool

endmenu

endif
```

## arch/arm/mach-pilot/Kconfig
```kconfig
config CPU_PILOT
	bool "Aspeed Pilot Architecture"
	select CPU_V7
	select PINCTRL
	select PINCTRL_PILOT
	select ARCH_REQUIRE_GPIOLIB
	select ARM_GIC
	select HAVE_ARM_TWD if SMP
	select HAVE_ARM_SCU if SMP
	select ARM_ERRATA_794072
	select ARM_ERRATA_720789
	select ARM_ERRATA_754322
	select ARM_ERRATA_764369 if SMP
	select MFD_SYSCON
	help
	  Support for the Aspeed's Pilot4 iBMC soc.
```

## arch/arm/mach-pilot4_asic/Kconfig
```kconfig
menuconfig MACH_PILOT4_ASIC
        bool "Pilot4 running on ASIC" if ARCH_MULTI_V7
        select GENERIC_TIME
        select GENERIC_CLOCKEVENTS
        select CLKDEV_LOOKUP
        select ARM_GIC
        select ARM_AMBA
        select HAVE_SMP
        select HAVE_ARM_SCU if SMP
        select HAVE_ARM_TWD if SMP
        select COMMON_CLK
        select MIGHT_HAVE_PCI
        select ARCH_SUPPORTS_MSI
	select ARCH_PILOT4
        help
          Support for Pilot4 running on Pilot4 ARM Cortex A9 Platform

config ARCH_PILOT4
    bool "Pilot4 Arch"
    default y
    depends on MACH_PILOT4_ASIC
    help
    this is help

config USE_SSP_RESET
	bool "PILOT4 CPU RESET FROM SSP"
	default n
	depends on MACH_PILOT4_ASIC
	help
	Enable this to make BMC CPU RESET from SSP to work Pilot 4

config PANIC_AND_BAIL_OUT
	bool "PILOT4 STACK DUMP ON WAIT LOOP TIME OUT"
	default n
	depends on MACH_PILOT4_ASIC
	help
	Enable this to generate stack dump when the wait loops time out
```

## drivers/crypto/aspeed/Kconfig
```kconfig
config CRYPTO_DEV_ASPEED
	tristate "Support for ASPEED Hash & Crypto Engice (HACE)"
	depends on ARCH_ASPEED
	select CRYPTO_CBC
	select CRYPTO_ECB
	select CRYPTO_AES
	select CRYPTO_MD5
	select CRYPTO_SHA256
	select CRYPTO_SHA512
	select CRYPTO_HMAC
	select CRYPTO_ALGAPI
	select CRYPTO_BLKCIPHER
	select CRYPTO_BLKCIPHER2
	  help
	    Say 'Y' here to use the AST Hash & Crypto Engine (HACE)

config CRYPTO_DEV_ASPEED_ABLK_INT
        bool "Enable Ablkcipher Interrupt"
        depends on CRYPTO_DEV_ASPEED
        default y

config CRYPTO_DEV_ASPEED_AKCIPHER_INT
        bool "Enable Akcipher Interrupt"
        depends on CRYPTO_DEV_ASPEED
        default y

config CRYPTO_DEV_ASPEED_AHASH_INT
        bool "Enable Ahash Interrupt"
        depends on CRYPTO_DEV_ASPEED
        default y

config CRYPTO_DEV_ASPEED_KPP_INT
        bool "Enable Kpp Interrupt"
        depends on CRYPTO_DEV_ASPEED
        default y
```

## drivers/mtd/spichips/Kconfig
```kconfig
# drivers/mtd/chips/Kconfig
# $Id: Kconfig,v 1.18 2005/11/07 11:14:22 gleixner Exp $

menu "SPI Flash chip drivers"
	depends on MTD!=n

config MTD_SPI
	bool "Enable MTD support on SPI devices"
	depends on MTD
	help
	  Select this if you want to access SPI flash devices via MTD

config MTD_SPI_INTEL_S33
	bool "Intel S33 SPI devices Support"
	depends on MTD_SPI && !SFDP
	help
	  Select this if you want to use Intel S33 SPI devices

config MTD_SPI_AT
	bool "Atmel SPI devices Support"
	depends on MTD_SPI && !SFDP
	help
	  Select this if you want to use Atmel SPI devices

config MTD_PILOT_AVL
	bool "Devices supported by Pilot4"
	depends on MTD_SPI
	help
	  Select this if you want to use SPI devices supported in Pilot4 SDK


config MTD_PILOT4_SPI
	bool "Pilot-4 SOC SPI Controller"
	depends on MTD_SPI && MTD_PILOT_SPI_MAP
	help 
	   If you are using SPI device on Pilot-4 SOC, select Y
	  


endmenu
```

## drivers/net/ethernet/pilot_tulip/Kconfig
```kconfig
#
# Tulip family network device configuration
#

#menu "Pilot4 Tulip family network device support"
#	depends on NET_ETHERNET && SOC_SE_PILOT4

config PILOT4_NET_TULIP
	depends on MACH_PILOT4 || MACH_PILOT4_F0 || MACH_PILOT4_ASIC
	tristate "\"Tulip\" family network device support for Aspeed Pilot."
	help
	  This selects the "Tulip" driver support for Aspeed Pilot.

config TULIP_NAPI
	bool "Use NAPI RX polling "
	depends on PILOT4_NET_TULIP
	help
	  NAPI is a new driver API designed to reduce CPU and interrupt load
	  when the driver is receiving lots of packets from the card. It is
	  still somewhat experimental and thus not yet enabled by default.

	  If your estimated Rx load is 10kpps or more, or if the card will be
	  deployed on potentially unfriendly networks (e.g. in a firewall),
	  then say Y here.

	  See <file:Documentation/networking/NAPI_HOWTO.txt> for more
	  information.

	  If in doubt, say N.

config TULIP_NAPI_HW_MITIGATION
	bool "Use Interrupt Mitigation "
	depends on TULIP_NAPI
	---help---
	  Use HW to reduce RX interrupts. Not strict necessary since NAPI reduces
	  RX interrupts but itself. Although this reduces RX interrupts even at
	  low levels traffic at the cost of a small latency.

	  If in doubt, say Y.

config PILOT_SG
	depends on MACH_PILOT4_ASIC
	bool "Enable SG support"
	help
	  Enable NIC Scatter/gather support and inform the Linux stack
```

## drivers/pinctrl/pilot/Kconfig
```kconfig
config PINCTRL_ASPEED_PILOT
        bool "Aspeed pilot pincontrol"
	depends on (ARCH_PILOT || COMPILE_TEST) && OF
	select PINMUX
	select PINCONF
	select GENERIC_PINCONF
	select REGMAP_MMIO
        help
          Say Y here to enable pin controller support for Aspeed's pilot 
          SoCs. GPIO is provided by a separate GPIO driver.
```

## drivers/soc/aspeed/Kconfig
```kconfig
# SPDX-License-Identifier: GPL-2.0-only
menu "Aspeed SoC drivers"

config SOC_ASPEED
	def_bool y
	depends on ARCH_ASPEED || COMPILE_TEST

config ASPEED_BMC_MISC
	bool "Miscellaneous ASPEED BMC interfaces"
	depends on ARCH_ASPEED || COMPILE_TEST
	default ARCH_ASPEED
	help
	  Say yes to expose VGA and LPC scratch registers, and other
	  miscellaneous control interfaces specific to the ASPEED BMC SoCs

config ASPEED_BMC_DEV
	tristate "ASPEED BMC Device"

config ASPEED_HOST_BMC_DEV
	tristate "ASPEED Host BMC Device"

config ASPEED_HID
	tristate "ASPEED HID"

config ASPEED_VIDEO
	tristate "ASPEED Video Engine driver"
	default n
	help
	  Driver for AST Video Engine

config ASPEED_LPC_CTRL
	depends on SOC_ASPEED && REGMAP && MFD_SYSCON
	tristate "Aspeed ast2400/2500 HOST LPC to BMC bridge control"
	---help---
	  Control Aspeed ast2400/2500 HOST LPC to BMC mappings through
	  ioctl()s, the driver also provides a read/write interface to a BMC ram
	  region where the host LPC read/write region can be buffered.

config ASPEED_LPC_SNOOP
	tristate "Aspeed ast2500 HOST LPC snoop support"
	depends on SOC_ASPEED && REGMAP && MFD_SYSCON
	help
	  Provides a driver to control the LPC snoop interface which
	  allows the BMC to listen on and save the data written by
	  the host to an arbitrary LPC I/O port.

config ASPEED_LPC_PCC
	tristate "Aspeed Post Code Capture support"
	depends on SOC_ASPEED && REGMAP && MFD_SYSCON
	help
	  Provides a driver to control the LPC PCC interface,
	  allowing the BMC to snoop data bytes written by the
	  the host to an arbitrary LPC I/O port.

config ASPEED_LPC_MBOX
	tristate "Aspeed LPC Mailbox Controller"
	depends on SOC_ASPEED && REGMAP && MFD_SYSCON
	help
	  Expose teh ASPEED LPC MBOX registers found on Aspeed SoCs
	  to userspace.

config ASPEED_P2A_CTRL
	depends on SOC_ASPEED && REGMAP && MFD_SYSCON
	tristate "Aspeed ast2400/2500 HOST P2A VGA MMIO to BMC bridge control"
	help
	  Control Aspeed ast2400/2500 HOST P2A VGA MMIO to BMC mappings through
	  ioctl()s, the driver also provides an interface for userspace mappings to
	  a pre-defined region.

config ASPEED_XDMA
	tristate "Aspeed XDMA Engine Driver"
	depends on SOC_ASPEED && REGMAP && MFD_SYSCON && HAS_DMA
	help
	  Enable support for the Aspeed XDMA Engine found on the Aspeed AST2XXX
	  SOCs. The XDMA engine can perform automatic PCI DMA operations
	  between the AST2XXX (acting as a BMC) and a host processor.

config ASPEED_HOST_XDMA
	tristate "ASPEED Host xDMA Device"

config ASPEED_VGA_SHAREDMEM
	tristate "Aspeed VGA Shared memory"
	depends on SOC_ASPEED
	help
	  To access VGA shared memory on Aspeed BMC, enable this option.
	  This driver used by ManagedDataRegionlV2 specification. In the
	  specification, BIOS will transfer whole SMBIOS table to VGA memory,
	  and BMC can get the table from VGA memory through this driver.

config ASPEED_MCTP
	tristate "Aspeed MCTP Engine Driver"
	depends on SOC_ASPEED && REGMAP && MFD_SYSCON
	help
	  Enable support for the Aspeed MCTP Engine found on the Aspeed AST2XXX
	  SOCs. The MCTP Engine receives Msg which carries MCTP packet through 
	  PCIe from Host or sends it to Host.

config ASPEED_UDMA
	tristate "Aspeed UDMA Engine Driver"
	depends on SOC_ASPEED && REGMAP && MFD_SYSCON && HAS_DMA
	help
	  Enable support for the Aspeed UDMA Engine found on the Aspeed AST2XXX
	  SOCs. The UDMA engine can perform UART DMA operations between the memory
	  buffer and the UART/VUART devices.

config ASPEED_ESPI
	tristate "Aspeed eSPI Engine Driver"
	depends on SOC_ASPEED && REGMAP && MFD_SYSCON
	help
	  Enable support for the Aspeed eSPI engine. The eSPI engine
	  plays as a slave device in BMC to communicate with the host
	  side master over the eSPI interface. The four eSPI channels,
	  namely peripheral, virtual wire, out-of-band, and flash are
	  supported.

config ASPEED_ESPI_MMBI
	tristate "Aspeed eSPI MMBI Driver"
	depends on ASPEED_ESPI
	help
	  Control Aspeed eSPI MMBI driver

config ASPEED_JTAG
	tristate "ASPEED JTAG Controller"
	default n
	help
	  Driver for JTAG Controller

config ASPEED_SSP
	tristate "ASPEED SSP loader"
        default n
        help
          Driver for loading secondary-service-processor binary

config ASPEED_UART_ROUTING
	tristate "Aspeed UART routing control"
	help
	  Control Aspeed UART routing via sysfs. This enables UART
	  and I/O components to be dynamically connected at runtime.

config ASPEED_VGA_SHAREDMEM
	tristate "Aspeed VGA Shared memory"
	depends on SOC_ASPEED
	help
	  To access VGA shared memory on Aspeed BMC, enable this option.
	  This driver used by ManagedDataRegionlV2 specification. In the
	  specification, BIOS will transfer whole SMBIOS table to VGA memory,
	  and BMC can get the table from VGA memory through this driver.

source "drivers/soc/aspeed/rvas/Kconfig"

endmenu
```
