## Documentation/devicetree/bindings/gpio/gpio-pilot.txt
```
PILOT GPIO controller Device Tree Bindings
-------------------------------------------
gpio-controller device node :

                pilot_gpio_ctrl: pilot_gpio@40423000 {
                        compatible = "aspeed,pilot-gpio";
                        reg = <0x40420000 0x1000>;
                        gpio-controller;
                        #gpio-cells = <2>;
                        gpio-ranges = <&pincontroller 0 0 186>;
                        interrupt-controller;
                        #interrupt-cells = <2>;
                        interrupts = <0 8 4>;
                        status = "disabled";

                };

- compatible            :  "aspeed,pilot-gpio"

- #gpio-cells           : Should be two
                          - First cell is the GPIO line number
                          - Second cell is used to specify optional
                            parameters (unused)

-gpio-ranges            : total 186 pins --->  gpio number 0 to 185
- reg                   : Address and length of the register set for the device

- gpio-controller       : Marks the device node as a GPIO controller.

- interrupts            : Interrupt specifier (see interrupt bindings for
                          details)
- interrupt-controller  : Mark the GPIO controller as an interrupt-controller


Bindings for Client driver nodes :
--------------------------------------------
sample DT node for client driver which uses GPIO_29_4:

sample-gpio-pin{
                compatible = "gpio-test-module";
                gpios = <&pilot_gpio_ctrl  140 GPIO_ACTIVE_LOW>;
                interrupt-parent = <&pilot_gpio_ctrl>;
                interrupts = <140 IRQ_TYPE_EDGE_RISING>;
                debounce-interval = <PILOT_DEBOUNCE_16MS>;
            };

sample DT node for client driver which uses GPIO_23:			
tempsensor-gpio-pin{
                compatible = "temp-sensor";
                gpios = <&pilot_gpio_ctrl  23 GPIO_ACTIVE_HIGH>;
                interrupt-parent = <&pilot_gpio_ctrl>;
                interrupts = <23 IRQ_TYPE_EDGE_FALLING>;
                debounce-interval = <PILOT_DEBOUNCE_8MS>;
            };


1) gpios = < phandle_of_gpio-controllernode , gpionumber , flags>

example:
gpios = <&pilot_gpio_ctrl 14  GPIO_ACTIVE_LOW>;  ----> GPIO_14
gpios = <&pilot_gpio_ctrl 34  GPIO_ACTIVE_HIGH>; -----> GPIO_29_2

gpio-number:
there are 45 ports 
Each gpio port has 8 pins:
gpios in port0 to port3 are designated as  GPIO_0 - GPIO_32 in data sheet.
These are not multiplexed with any other functionality.

gpios in port16 to port29 are designated as (GPIO_16_0,GPIO_16_1,....GPIO_29_4,GPIO_29_5) in datasheet.
These are multiplexed with other pin functionalities.

gpios in port40 to port45 are designated as (GPIO_30_0 ,GPIO_30_1,....GPIO_45_2,GPIO_45_3) in datasheet.
these are multiplexed with other pin functionalities.

(port4 to port15) , (port30 to port39) - are serialGPIO ports and are not supported by  "drivers/gpio/gpio-pilot.c"

gpio numbers  assigned by  the gpio-driver: "drivers/gpio/gpio-pilot.c" to these gpios are as below:
port0 to port3 ==> gpio0 to gpio31
port16 to port29(29_0 to 29_5)==> gpio32 to gpio141
port40 to port45(45_0 to 45_3) ==> gpio142 to gpio185

these numbers can also be looked up at "drivers/pinctrl/pilot/pilot4_pinctrl_drv.c"
pin numbers in pilot4_pinctrl_drv.c are Ensured to be same as gpionumbers of pins.

2) to  specify irq number and Interrupt type in DT node:

	interrupt-parent = <&pilot_gpio_ctrl>;
	interrupts = < 184  IRQ_TYPE_EDGE_RISING>; ---> interrupt on GPIO_45_2

	
interrupt number is same as gpio number.
Interrupt types supported :
 IRQ_TYPE_EDGE_RISING,
IRQ_TYPE_EDGE_FALLING,
IRQ_TYPE_LEVEL_HIGH,
IRQ_TYPE_LEVEL_LOW

3)  debounce-interval = <debounce-period>
example:
		debounce-interval = <PILOT_DEBOUNCE_16MS>;

vaild debounce period can be found in include/dt-bindings/gpio/pilot-gpio.h


reference:
- Documentation/devicetree/bindings/gpio/gpio.txt
- Documentation/devicetree/bindings/interrupt-controller/interrupts.txt
```

## Documentation/devicetree/bindings/hwmon/aspeed,ast2600-tach.txt
```
ASPEED AST2600 Fan Tacho controller device driver

The ASPEED Fan Tacho controller can support upto 16 Fan tachometer inputs.

Required properties for tacho node:
- #address-cells : should be 1.

- #size-cells : should be 1.

- reg : address and length of the register set for the device.

- pinctrl-names : a pinctrl state named "default" must be defined.

- pinctrl-0 : phandle referencing pin configuration of the PWM ports.

- compatible : should be "aspeed,ast2600-tach"

- clocks : phandle to clock provider with the clock number in the second cell

- resets : phandle to reset controller with the reset number in the second cell

fan subnode format:
===================
Under fan subnode there can upto 16 child nodes, with each child node
representing a fan.

Required properties for each child node:
- aspeed,fan-tach-ch : should specify the Fan tach input channel.
                integer value in the range 0 through 15, with 0 indicating
		Fan tach channel 0 and 15 indicating Fan tach channel 15.
		Atleast one Fan tach input channel is required.
- aspeed,pulse-pr : define the tachometer pulses per fan revolution as
            	an integer (default is 2 interrupts per revolution).
            	The value must be greater than zero.
- aspeed,min-rpm : define the minimal revolutions per minute of the measure fan
		used to calculate the sample period of tach
- aspeed,tacho-div : define the tachometer clock divider as an integer
		(default is 5). formula of tacho clock = HCLK / (2^tacho-div)^2

Examples:

pwm_tach: pwm_tach@1e610000 {
	compatible = "simple-mfd", "syscon";
	#address-cells = <1>;
	#size-cells = <1>;
	reg = <0x1e610000 0x100>;
	ranges = <0 0x1e610000 0x100>;
	pwm: pwm@0 {
		compatible = "aspeed,ast2600-pwm";
		#address-cells = <1>;
		#size-cells = <0>;
		#pwm-cells = <3>;
		reg = <0x0 0x100>;
		clocks = <&syscon ASPEED_CLK_AHB>;
		resets = <&syscon ASPEED_RESET_PWM>;
		status = "disabled";
	};
	tach: tach@0 {
		compatible = "aspeed,ast2600-tach";
		#address-cells = <1>;
		#size-cells = <0>;
		reg = <0x0 0x100>;
		clocks = <&syscon ASPEED_CLK_AHB>;
		resets = <&syscon ASPEED_RESET_PWM>;
		status = "disabled";
	};
};


&tach {
	status = "okay";
	pinctrl-names = "default";
	pinctrl-0 = <&pinctrl_tach0_default
			...>;
	fan@0 {
		aspeed,tach-ch = <0x00>;
		aspeed,pulse-pr = <2>;
		aspeed,min-rpm = <1000>;
		aspeed,tacho-div = <5>;
	};
        ...
}
```

## Documentation/devicetree/bindings/hwmon/aspeed,ast2600-tach.yaml
```yaml
# SPDX-License-Identifier: (GPL-2.0-only OR BSD-2-Clause)
# Copyright (C) 2021 ASPEED, Inc.
%YAML 1.2
---
$id: http://devicetree.org/schemas/hwmon/aspeed,ast2600-tach.yaml#
$schema: http://devicetree.org/meta-schemas/core.yaml#

title: ASPEED AST2600 Tach controller

maintainers:
  - Billy Tsai <billy_tsai@aspeedtech.com>

description: |
  The ASPEED Tach controller can support upto 16 fan input.
  This module is part of the ast2600-pwm-tach multi-function device. For more
  details see ../mfd/aspeed,ast2600-pwm-tach.yaml.

properties:
  compatible:
    enum:
      - aspeed,ast2600-tach

  "#address-cells":
    const: 1

  "#size-cells":
    const: 0

  pinctrl-0: true

  pinctrl-names:
    const: default


required:
  - compatible
  - "#address-cells"
  - "#size-cells"

child-node:
  type: object
  properties:
    reg:
      description:
        The tach channel used for this fan.
      maxItems: 1
    aspeed,min-rpm:
      description:
        define the minimal revolutions per minute of the measure fan
        used to calculate the sample period of tach
      default: 1000
    aspeed,pulse-pr:
      description:
        Value specifying the number of pulses per revolution of the
        monitored FAN.
      default: 2
    aspeed,tach-div:
      description:
        define the tachometer clock divider as an integer. Formula of
        tach clock = clock source / (2^tach-div)^2
      minimum: 0
      maximum: 15
      # The value that should be used if the property is not present
      default: 5
  required:
    - reg
```

## Documentation/devicetree/bindings/hwmon/aspeed2600-pwm-tacho.txt
```
ASPEED AST2600 PWM and Fan Tacho controller device driver

The ASPEED PWM controller can support upto 16 PWM outputs. The ASPEED Fan Tacho
controller can support upto 16 Fan tachometer inputs.

There can be upto 16 fans supported. Each fan can have one PWM output and
one/two Fan tach inputs.

Required properties for pwm-tacho node:
- #address-cells : should be 1.

- #size-cells : should be 1.

- #cooling-cells: Please refer to Documentation/devicetree/bindings/thermal/thermal.txt.

- reg : address and length of the register set for the device.

- pinctrl-names : a pinctrl state named "default" must be defined.

- pinctrl-0 : phandle referencing pin configuration of the PWM ports.

- compatible : should be "aspeed,ast2400-pwm-tacho" for AST2400 and
	       "aspeed,ast2500-pwm-tacho" for AST2500.

- clocks : phandle to clock provider with the clock number in the second cell

- resets : phandle to reset controller with the reset number in the second cell

fan subnode format:
===================
Under fan subnode there can upto 8 child nodes, with each child node
representing a fan. If there are 8 fans each fan can have one PWM port and
one/two Fan tach inputs.
For PWM port can be configured cooling-levels to create cooling device.
Cooling device could be bound to a thermal zone for the thermal control.

Required properties for each child node:
- reg : should specify PWM source port.
	integer value in the range 0 to 16 with 0 indicating PWM port A and
	15 indicating PWM port P.

- cooling-levels: PWM duty cycle values in a range from 0 to 255
                  which correspond to thermal cooling states.

- aspeed,target_pwm: define the pwm frequency
- aspeed,default-duty-point: define the defult duty point of pwm (0~255)
- aspeed,fan-tach-ch : should specify the Fan tach input channel.
                integer value in the range 0 through 15, with 0 indicating
		Fan tach channel 0 and 15 indicating Fan tach channel 15.
		Atleast one Fan tach input channel is required.
- aspeed,pulse-pr : define the tachometer pulses per fan revolution as
            an integer (default is 2 interrupts per revolution).
            The value must be greater than zero.
- aspeed,min-rpm : define the minimal revolutions per minute of the measure fan 
					used to caculate the sample period of tach
- aspeed,tacho-div : define the tachometer clock divider as an integer (default is 5).
            formula of tacho clock = HCLK / (2^tacho-div)^2
- aspeed,wdt-reload-enable: Enable the function of wdt reset reload duty point.
- aspeed,wdt-reload-duty-point: define the duty point after wdt reset. (0~255)
Examples:

pwm_tacho: pwm-tacho-controller@1e610000 {
    compatible = "aspeed,ast2600-pwm-tachometer";
    #address-cells = <1>;
    #size-cells = <0>;
    reg = <0x1e610000 0x100>;
    clocks = <&syscon ASPEED_CLK_AHB>;
    resets = <&syscon ASPEED_RESET_PWM>;
	pinctrl-names = "default";
	pinctrl-0 = <&pinctrl_pwm0_default &pinctrl_tach0_default
			&pinctrl_pwm1_default &pinctrl_tach1_default
			&pinctrl_pwm2_default &pinctrl_tach2_default
			&pinctrl_pwm3_default &pinctrl_tach3_default
			&pinctrl_pwm4_default &pinctrl_tach4_default
			&pinctrl_pwm5_default &pinctrl_tach5_default
			&pinctrl_pwm6_default &pinctrl_tach6_default
			&pinctrl_pwm7_default &pinctrl_tach7_default
			&pinctrl_pwm8g1_default &pinctrl_tach8_default
			&pinctrl_pwm9g1_default &pinctrl_tach9_default
			&pinctrl_pwm10g1_default &pinctrl_tach10_default
			&pinctrl_pwm11g1_default &pinctrl_tach11_default
			&pinctrl_pwm12g1_default &pinctrl_tach12_default
			&pinctrl_pwm13g1_default &pinctrl_tach13_default
			&pinctrl_pwm14g1_default &pinctrl_tach14_default
			&pinctrl_pwm15g1_default &pinctrl_tach15_default>;

	fan@0 {
		reg = <0x00>;
		aspeed,target_pwm = <25000>;
		aspeed,default-duty-point = <128>;
		cooling-levels = /bits/ 8 <125 151 177 203 229 255>;
		aspeed,fan-tach-ch = /bits/ 8 <0x00>;
		aspeed,tacho-div = <5>;
		aspeed,pulse-pr = <2>;
		aspeed,min-rpm = <1000>;
		aspeed,wdt-reload-enable;
		aspeed,wdt-reload-duty-point = <1>;
	};
};
```

## Documentation/devicetree/bindings/iio/adc/aspeed_adc.txt
```
Aspeed ADC

This device is a 10-bit converter for 16 voltage channels.  All inputs are
single ended.

After ast2600, This device split into two individual IPs and each contains 8 voltage channels.

Chip level dtsi:
Required properties:
- compatible: Should be "aspeed,ast2400-adc" or "aspeed,ast2500-adc" or "aspeed,ast2600-adc"
- reg: memory window mapping address and length
- clocks: Input clock used to derive the sample clock. Expected to be the
          SoC's APB clock.
- resets: Reset controller phandle
- #io-channel-cells: Must be set to <1> to indicate channels are selected
                     by index.

Example:
adc0: adc@1e6e9000 {
		compatible = "aspeed,ast2600-adc0";
		reg = <0x1e6e9000 0x100>;
		clocks = <&syscon ASPEED_CLK_APB2>;
		resets = <&syscon ASPEED_RESET_ADC>;
		interrupts = <GIC_SPI 46 IRQ_TYPE_LEVEL_HIGH>;
		#io-channel-cells = <1>;
		status = "disabled"; 
	}; 
adc1: adc@1e6e9100 {
	compatible = "aspeed,ast2600-adc1";
	reg = <0x1e6e9100 0x100>;
	clocks = <&syscon ASPEED_CLK_APB2>;
	resets = <&syscon ASPEED_RESET_ADC>;
	interrupts = <GIC_SPI 46 IRQ_TYPE_LEVEL_HIGH>;
	#io-channel-cells = <1>;
	status = "disabled";
};
Board level dts:
Required properties:
- vref: (ast2600 only)
	- Reference voltage in millivolts for the conversions
- battery-sensing: (ast2600 only)
	- Inform the driver that last channel will be used to sensor battery
- aspeed,trim-data-valid:
	- type: boolean
	- description:
	The ADC reference voltage can be calibrated to obtain the trimming
	data which will be stored in otp. This property informs the driver that
	the data store in the otp is valid.
Example:
&adc0 {
	vref = <2500>;
	status = "okay";
	battery-sensing;

	pinctrl-0 = <&pinctrl_adc0_default &pinctrl_adc1_default
		&pinctrl_adc2_default &pinctrl_adc3_default
		&pinctrl_adc4_default &pinctrl_adc5_default
		&pinctrl_adc6_default &pinctrl_adc7_default>;
};

&adc1 {
	vref = <1800>;
	status = "okay";

	pinctrl-0 = <&pinctrl_adc8_default &pinctrl_adc9_default
		&pinctrl_adc10_default &pinctrl_adc11_default
		&pinctrl_adc12_default &pinctrl_adc13_default
		&pinctrl_adc14_default &pinctrl_adc15_default>;
};
```

## Documentation/devicetree/bindings/ipmi/aspeed-ssif-bmc.yaml
```yaml
# SPDX-License-Identifier: (GPL-2.0-only OR BSD-2-Clause)
%YAML 1.2
---
$id: http://devicetree.org/schemas/ipmi/aspeed-ssif-bmc.yaml#
$schema: http://devicetree.org/meta-schemas/core.yaml#

title: Aspeed SSIF IPMI interface

description: SSIF IPMI device bindings for Aspeed

maintainers:
  - Thang Nguyen <thangqn@amperecomputing.com>

properties:
  compatible:
    enum:
      "aspeed,ast2500-ssif-bmc"
  reg:
    maxItems: 1

required:
  - compatible
  - reg

examples:
  - |
    ssif-bmc@10 {
        compatible = "aspeed,ast2500-ssif-bmc";
        reg = <0x10>;
    };
```
